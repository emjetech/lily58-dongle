## boards/shields/lily58/Kconfig.shield
```kconfig
# Copyright (c) 2020 The ZMK Contributors
# SPDX-License-Identifier: MIT

config SHIELD_LILY58_DONGLE
	def_bool $(shields_list_contains,lily58_dongle)

config SHIELD_LILY58_LEFT
    def_bool $(shields_list_contains,lily58_left)

config SHIELD_LILY58_RIGHT
    def_bool $(shields_list_contains,lily58_right)
```
